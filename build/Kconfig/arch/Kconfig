## build/Kconfig/arch/Kconfig
```kconfig
# Load Zephyr Arch Kconfig descriptions.
osource "/home/tl/Desktop/zephyr/zephyrproject/zephyr/arch/rx/Kconfig"
osource "/home/tl/Desktop/zephyr/zephyrproject/zephyr/arch/x86/Kconfig"
osource "/home/tl/Desktop/zephyr/zephyrproject/zephyr/arch/xtensa/Kconfig"
osource "/home/tl/Desktop/zephyr/zephyrproject/zephyr/arch/sparc/Kconfig"
osource "/home/tl/Desktop/zephyr/zephyrproject/zephyr/arch/riscv/Kconfig"
osource "/home/tl/Desktop/zephyr/zephyrproject/zephyr/arch/posix/Kconfig"
osource "/home/tl/Desktop/zephyr/zephyrproject/zephyr/arch/openrisc/Kconfig"
osource "/home/tl/Desktop/zephyr/zephyrproject/zephyr/arch/mips/Kconfig"
osource "/home/tl/Desktop/zephyr/zephyrproject/zephyr/arch/arm64/Kconfig"
osource "/home/tl/Desktop/zephyr/zephyrproject/zephyr/arch/arm/Kconfig"
osource "/home/tl/Desktop/zephyr/zephyrproject/zephyr/arch/arc/Kconfig"
```

## build/Kconfig/boards/Kconfig
```kconfig
# Load Zephyr board Kconfig descriptions.
osource "/home/placidocordeiro/zephyrproject/zephyr/boards/native/native_sim/Kconfig"
```

## build/Kconfig/boards/Kconfig.defconfig
```kconfig
# Load Zephyr board defconfig descriptions.
osource "/home/placidocordeiro/zephyrproject/zephyr/boards/native/native_sim/Kconfig.defconfig"
```

## build/Kconfig/boards/Kconfig.defconfig.tmp
```kconfig
# Load Zephyr board defconfig descriptions.
osource "/home/tl/Desktop/zephyr/zephyrproject/zephyr/boards/native/native_sim/Kconfig.defconfig"
```

## build/Kconfig/boards/Kconfig.native_sim
```kconfig
# Load board Kconfig descriptions.
osource "/home/tl/Desktop/zephyr/zephyrproject/zephyr/boards/native/native_sim/Kconfig.native_sim"
```

## build/Kconfig/boards/Kconfig.sysbuild
```kconfig
# Load Sysbuild board Kconfig descriptions.
osource "/home/placidocordeiro/zephyrproject/zephyr/boards/native/native_sim/Kconfig.sysbuild"
```

## build/Kconfig/boards/Kconfig.sysbuild.tmp
```kconfig
# Load Sysbuild board Kconfig descriptions.
osource "/home/tl/Desktop/zephyr/zephyrproject/zephyr/boards/native/native_sim/Kconfig.sysbuild"
```

## leds/Kconfig.leds
```kconfig
# SPDX-License-Identifier: Apache-2.0
config APP_LEDS_SLOW_MS
	int "Intervalo entre trocas de estado do padrão LENTO (ms)"
	default 1000
	range 1 600000
	help
	  Tempo que o LED fica ligado (e depois desligado) no padrão lento.

config APP_LEDS_NORMAL_MS
	int "Intervalo entre trocas de estado do padrão PADRÃO (ms)"
	default 500
	range 1 600000

config APP_LEDS_FAST_MS
	int "Intervalo entre trocas de estado do padrão RÁPIDO (ms)"
	default 150
	range 1 600000

module = APP_LEDS
module-str = leds
source "subsys/logging/Kconfig.template.log_config"
```

## tests/dispatch/testcase.yaml
```yaml
tests:
  dispatch.dispatch:
    platform_allow: native_sim
    integration_platforms:
      - native_sim
    tags: dispatch
```

## tests/unit/testcase.yaml
```yaml
common:
  tags: led
  platform_allow: native_sim
  integration_platforms:
    - native_sim

tests:
  led.unit:
    extra_args: DTC_OVERLAY_FILE="app.overlay"

  led.unit.not_ready:
    extra_args: DTC_OVERLAY_FILE="app.overlay;not_ready.overlay"
    extra_configs:
      - CONFIG_LED_TEST_NOT_READY=y
```

## tests/unit_not_ready/Kconfig
```kconfig
# SPDX-License-Identifier: Apache-2.0

rsource "../../leds/Kconfig.leds"

source "Kconfig.zephyr"
```

## tests/unit_not_ready/testcase.yaml
```yaml
tests:
  leds.unit.not_ready:
    platform_allow: native_sim
    integration_platforms:
      - native_sim
    tags: leds
```

## twister-out/native_sim_native/host_gnu/ECOM042-monitoria/tests/unit/minish.unit/Kconfig/boards/Kconfig.defconfig
```kconfig
# Load Zephyr board defconfig descriptions.
osource "/home/matheus/zephyrproject/zephyr/boards/native/native_sim/Kconfig.defconfig"
```

## twister-out/native_sim_native/host_gnu/ECOM042-monitoria/tests/unit/minish.unit/Kconfig/boards/Kconfig.sysbuild
```kconfig
# Load Sysbuild board Kconfig descriptions.
osource "/home/matheus/zephyrproject/zephyr/boards/native/native_sim/Kconfig.sysbuild"
```

## west.yml
```yaml
manifest:
  remotes:
    - name: upstream
      url-base: https://github.com/zephyrproject-rtos
  projects:
    - name: zephyr
      remote: upstream
      revision: main
      import: true
  self:
    path: application
```
